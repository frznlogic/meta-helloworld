## conf/bblayers.conf
```bitbake
# POKY_BBLAYERS_CONF_VERSION is increased each time build/conf/bblayers.conf
# changes incompatibly
POKY_BBLAYERS_CONF_VERSION = "2"

BBPATH = "${TOPDIR}"
BBFILES ?= ""

BBLAYERS ?= " \
  /home/osan/Projects/linux-tug/helloworld/source/poky/meta \
  /home/osan/Projects/linux-tug/helloworld/source/poky/meta-poky \
  /home/osan/Projects/linux-tug/helloworld/source/poky/meta-yocto-bsp \
  /home/osan/Projects/linux-tug/helloworld/source/meta-helloworld \
  "
```
